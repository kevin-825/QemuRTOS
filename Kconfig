## Kconfig
```kconfig
# QemuRTOS / Top-Level Kconfig

mainmenu "QemuRTOS Configuration"

source "boards/Kconfig"
source "chip/Kconfig"
source "arch/Kconfig"
source "kernel/Kconfig"
source "drivers/Kconfig"
source "mm/Kconfig"

config DEBUG
    bool "enable debug"
    default y

config ASSERT
    bool "enable assert and panic"
    default y
```

## arch/Kconfig
```kconfig
# arch/Kconfig

config ARCH_ARM
    bool
    help
      ARM 32-bit Architecture

config ARCH_ARM64
    bool
    help
      ARM 64-bit Architecture (AArch64)

config ARCH_RISCV
    bool
    help
      RISC-V Architecture

config ARCH_NAME
    string
    default "riscv" if ARCH_RISCV
    default "arm64" if ARCH_ARM64
    default "arm" if ARCH_ARM

config CROSS_COMPILE
    string
    default "riscv64-unknown-elf-" if ARCH_RISCV
    default "aarch64-linux-gnu-" if ARCH_ARM64
    default "arm-none-eabi-" if ARCH_ARM
```

## boards/Kconfig
```kconfig
# boards/Kconfig

choice
    prompt "Select Target Board"
    default BOARD_QEMU_VIRT_RV64

config BOARD_QEMU_VIRT_ARM
    bool "QEMU ARM 32-bit Virt Board"
    select CHIP_QEMU_VIRT_ARM
    select SERIAL_PL011
    help

config BOARD_QEMU_VIRT_AARCH64
    bool "QEMU ARM 64-bit Virt Board"
    select CHIP_QEMU_VIRT_AARCH64
    select SERIAL_PL011
    help

config BOARD_QEMU_VIRT_RV32
    bool "QEMU RISC-V 32-bit Virt Board"
    select CHIP_QEMU_VIRT_RV32
    select SERIAL_NS16550


config BOARD_QEMU_VIRT_RV64
    bool "QEMU RISC-V 64-bit Virt Board"
    select CHIP_QEMU_VIRT_RV64
    select SERIAL_NS16550

endchoice

config BOARD_DIR
    string
    default "riscv/qemu_virt_rv64gc" if BOARD_QEMU_VIRT_RV64
    default "riscv/qemu_virt_rv32gc" if BOARD_QEMU_VIRT_RV32
    default "arm/qemu_virt_aarch64" if BOARD_QEMU_VIRT_AARCH64
    default "arm/qemu_virt_arm" if BOARD_QEMU_VIRT_ARM



menu "Device Tree Architecture"

choice
    prompt "Device Tree Parsing Strategy"
    default DTB_DYNAMIC

config DTB_DYNAMIC
    bool "Dynamic Runtime Parsing (Linux-style libfdt)"
    help
      Embeds libfdt. The OS will parse the binary .dtb in RAM during 
      early boot. Best for flexibility and learning Linux internals.

config DTB_STATIC
    bool "Static Compile-Time Macros (Zephyr-style)"
    help
      Relies on hardcoded C macros defined at compile time. 
      Zero runtime RAM/CPU overhead. Best for tiny microcontrollers.

endchoice

endmenu
```

## chip/Kconfig
```kconfig
# chip/Kconfig

config CHIP_QEMU_VIRT_ARM
    bool
    select ARCH_ARM

config CHIP_QEMU_VIRT_AARCH64
    bool
    select ARCH_ARM64

config CHIP_QEMU_VIRT_RV32
    bool
    select ARCH_RISCV

config CHIP_QEMU_VIRT_RV64
    bool
    select ARCH_RISCV

config 64BIT
    bool
    default y if CHIP_QEMU_VIRT_RV64 || CHIP_QEMU_VIRT_ARM64
    default n

# chip/Kconfig (at the bottom)

config CHIP_DIR
    string
    default "qemu/virt_riscv64" if CHIP_QEMU_VIRT_RV64
    default "qemu/virt_riscv32" if CHIP_QEMU_VIRT_RV32
    default "qemu/virt_aarch64" if CHIP_QEMU_VIRT_AARCH64
    default "qemu/virt_arm" if CHIP_QEMU_VIRT_ARM
```

## drivers/Kconfig
```kconfig
menu "Device Drivers"

# Source the serial drivers menu
source "drivers/serial/Kconfig"


endmenu
```

## drivers/serial/Kconfig
```kconfig
menu "Serial Drivers"

config SERIAL_NS16550
    bool "NS16550 UART driver"
    default y if ARCH_RISCV
    help
      Enable the driver for the NS16550 UART.
      This is the standard serial controller used by the QEMU RISC-V 
      'virt' machine and many PC-like architectures.

config SERIAL_PL011
    bool "ARM PrimeCell PL011 UART driver"
    default y if ARCH_AARCH64 || ARCH_ARM
    help
      Enable the driver for the ARM PL011 UART.
      This is the standard serial controller used by the QEMU AArch64 
      'virt' machine and Raspberry Pi boards.

endmenu
```

## mm/Kconfig
```kconfig
menu "Memory Management Configuration"

choice 
    prompt "Select Memory Management Strategy"
    default MM_SIMPLE

config MM_SIMPLE
    bool "Simple First-Fit Memory Allocator"
    help
      A simple memory allocator that uses a first-fit strategy. 
      It maintains a linked list of free blocks and splits them as needed.
      This allocator is easy to implement but may lead to fragmentation over time.


endchoice



choice 
    prompt "Enable Memory Management Debugging"
    default MM_DEBUG

config MM_DEBUG
    bool "Enable Debugging for Memory Management"
    depends on MM_SIMPLE
    help
      Enable additional debugging output for the simple memory allocator. 
      This can help identify issues with memory allocation and deallocation, 
      but may reduce performance due to increased logging.
endchoice

endmenu
```
